## main/Kconfig.projbuild
```kconfig
menu "LCM4ESP32 Configuration"

    config LCM_REPO
        string "User Repo"
        default "HomeACcessorykid/lcm-demo"
        help
            name of the repo with the user firmware image.

    config LCM_GITHOST
        string "Host name of GIT release server"
        default "github.com"
        help
            hostname of server which hosts the images.

    config LCM_GITREPO
        string "User Repo"
        default "HomeACcessorykid/LCM4ESP32"
        help
            name of the repo with the LCM firmware images.

endmenu
```

## sdkconfig.defaults
```kconfig
# Default sdkconfig parameters to use the OTA
# partition table layout, with a 4MB flash size
CONFIG_ESPTOOLPY_FLASHSIZE_4MB=y
CONFIG_PARTITION_TABLE_CUSTOM=y
CONFIG_ESP_HTTPS_SERVER_ENABLE=y
CONFIG_ESP_TASK_WDT_TIMEOUT_S=10
CONFIG_MBEDTLS_HAVE_TIME_DATE=y
CONFIG_LOG_COLORS=n
CONFIG_BOOTLOADER_RESERVE_RTC_SIZE=0x10
CONFIG_BOOTLOADER_CUSTOM_RESERVE_RTC=y
CONFIG_BOOTLOADER_CUSTOM_RESERVE_RTC_SIZE=0x04
CONFIG_NEWLIB_NANO_FORMAT=y
CONFIG_LOG_DEFAULT_LEVEL_WARN=y
#
```
